## firmware/overlay/nrf/subsys/bluetooth/services/cgms/Kconfig.cgms
```kconfig
#
# Copyright (c) 2022 Nordic Semiconductor ASA
#
# SPDX-License-Identifier: LicenseRef-Nordic-5-Clause
#

menuconfig BT_CGMS
	bool "GATT continuous glucose service"
	select EXPERIMENTAL
	select BT_NRF_SERVICES

if BT_CGMS

config BT_CGMS_MAX_MEASUREMENT_RECORD
	int "Maximum number of stored records"
	default 100
	help
	  The maximum number of stored measurement records. This value
	  should be large enough to hold measurements that are generated
	  in a session. This pool is allocated per CGMS instance, so the
	  total cost scales with BT_CGMS_INSTANCE_COUNT.

config BT_CGMS_INSTANCE_COUNT
	int "Number of CGMS instances"
	default 1
	range 1 254
	help
	  The number of independent Continuous Glucose Monitoring Service
	  instances bt_cgms_init() can hand out. Each instance is a fully
	  separate virtual sensor: its own GATT service registration, session
	  state, and RACP measurement database. Most applications only need
	  one sensor per device and should leave this at the default.

module = BT_CGMS
module-str = CGMS
source "$(ZEPHYR_BASE)/subsys/logging/Kconfig.template.log_config"

endif # BT_CGMS
```
