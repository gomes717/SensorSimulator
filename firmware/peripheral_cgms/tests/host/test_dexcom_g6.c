/*
 * Host test (runs on the PC, no board, no Zephyr) of src/aes128.c and src/dexcom_g6.c against the
 * golden vectors shared with the Python twin. Built and run by tests/test_dexcom_g6_c.py, or by hand:
 *
 *   cc -std=c99 -Wall -Wextra -I../../src -o test_g6 test_dexcom_g6.c ../../src/dexcom_g6.c \
 *      ../../src/aes128.c -lm && ./test_g6
 *
 * g6_vectors.h is generated by scripts/make_dexcom_g6_vectors.py.
 */

#include <stdio.h>
#include <stdlib.h>
#include <string.h>

#include "aes128.h"
#include "dexcom_g6.h"
#include "g6_vectors.h"

static int total, failed;

#define CHECK(cond)                                                                               \
	do {                                                                                      \
		total++;                                                                          \
		if (!(cond)) {                                                                    \
			failed++;                                                                 \
			printf("  FAIL  %s:%d  (%s)\n", __FILE__, __LINE__, #cond);               \
		}                                                                                 \
	} while (0)

#define CHECK_BYTES(got, want, what)                                                              \
	do {                                                                                      \
		total++;                                                                          \
		if (!bytes_eq((got), (want))) {                                                   \
			failed++;                                                                 \
			printf("  FAIL  %s:%d  %s\n        got  %s\n        want %s\n", __FILE__,   \
			       __LINE__, what, hex_of(got), (want));                              \
		}                                                                                 \
	} while (0)

/* ---- hex helpers ------------------------------------------------------------------------- */

static size_t from_hex(const char *hex, uint8_t *out, size_t cap)
{
	size_t n = strlen(hex) / 2;

	if (n > cap) {
		n = cap;
	}
	for (size_t i = 0; i < n; i++) {
		unsigned v;

		sscanf(hex + 2 * i, "%2x", &v);
		out[i] = (uint8_t)v;
	}
	return n;
}

struct blob {
	uint8_t data[64];
	size_t len;
};

static struct blob blob_of(const uint8_t *p, size_t len)
{
	struct blob b = {.len = len};

	memcpy(b.data, p, len);
	return b;
}

static const char *hex_of(struct blob b)
{
	static char buf[4][160];
	static int slot;
	char *s = buf[slot++ % 4];

	for (size_t i = 0; i < b.len; i++) {
		sprintf(s + 2 * i, "%02x", b.data[i]);
	}
	s[2 * b.len] = '\0';
	return s;
}

static int bytes_eq(struct blob b, const char *want)
{
	return strcmp(hex_of(b), want) == 0;
}

/* ---- tests ------------------------------------------------------------------------------- */

static void test_crc(void)
{
	for (size_t i = 0; i < sizeof G6V_CRC / sizeof G6V_CRC[0]; i++) {
		uint8_t d[64];
		size_t n = from_hex(G6V_CRC[i].data, d, sizeof d);

		CHECK(g6_crc16(d, n) == G6V_CRC[i].crc);
	}
	CHECK(g6_crc16((const uint8_t *)"123456789", 9) == 0x31C3);
}

static void test_aes(void)
{
	for (size_t i = 0; i < sizeof G6V_AES / sizeof G6V_AES[0]; i++) {
		uint8_t key[16], in[16], out[16];

		from_hex(G6V_AES[i].key, key, 16);
		from_hex(G6V_AES[i].plain, in, 16);
		aes128_encrypt_block(key, in, out);
		CHECK_BYTES(blob_of(out, 16), G6V_AES[i].cipher, "aes");
	}
}

static void test_hash(void)
{
	for (size_t i = 0; i < sizeof G6V_HASH / sizeof G6V_HASH[0]; i++) {
		uint8_t in[8], out[8];

		from_hex(G6V_HASH[i].data, in, 8);
		g6_challenge_hash(G6V_HASH[i].id, in, out);
		CHECK_BYTES(blob_of(out, 8), G6V_HASH[i].hash, "challenge hash");
	}
}

static void test_ids_and_names(void)
{
	char name[G6_NAME_BUF];

	CHECK(g6_valid_id("8SIM00", 6));
	CHECK(!g6_valid_id("8SIM0", 5));
	CHECK(!g6_valid_id("8SIM000", 7));
	CHECK(!g6_valid_id("8sim00", 6));
	CHECK(!g6_valid_id("8SIM 0", 6));
	g6_adv_name("8AB1CD", name);
	CHECK(strcmp(name, "DexcomCD") == 0);
}

static void test_auth_flow(void)
{
	struct g6_session s = {0};
	uint8_t in[16], rnd[8], out[G6_MAX_REPLY];
	size_t n;

	from_hex(G6V_AUTH.random, rnd, 8);

	n = from_hex(G6V_AUTH.request, in, sizeof in);
	CHECK(g6_auth_handle(&s, G6V_AUTH.id, in, n, rnd, out, &n));
	CHECK_BYTES(blob_of(out, n), G6V_AUTH.challenge, "challenge");
	CHECK(!s.authenticated);

	n = from_hex(G6V_AUTH.reply, in, sizeof in);
	CHECK(g6_auth_handle(&s, G6V_AUTH.id, in, n, rnd, out, &n));
	CHECK_BYTES(blob_of(out, n), G6V_AUTH.status, "status");
	CHECK(s.authenticated);

	/* a wrong reply is refused */
	memset(&s, 0, sizeof s);
	n = from_hex(G6V_AUTH.request, in, sizeof in);
	g6_auth_handle(&s, G6V_AUTH.id, in, n, rnd, out, &n);
	n = from_hex(G6V_AUTH.wrong_reply, in, sizeof in);
	CHECK(g6_auth_handle(&s, G6V_AUTH.id, in, n, rnd, out, &n));
	CHECK_BYTES(blob_of(out, n), G6V_AUTH.wrong_status, "wrong status");
	CHECK(!s.authenticated);

	/* a reply with no request in front of it is refused */
	memset(&s, 0, sizeof s);
	n = from_hex(G6V_AUTH.reply, in, sizeof in);
	CHECK(g6_auth_handle(&s, G6V_AUTH.id, in, n, rnd, out, &n));
	CHECK(!s.authenticated);
}

static void test_auth_malformed(void)
{
	struct g6_session s = {0};
	uint8_t rnd[8] = {0}, out[G6_MAX_REPLY];
	size_t n;
	const uint8_t short_req[] = {0x01, 0, 0, 0};
	const uint8_t unknown[] = {0x99, 0};
	const uint8_t keep_alive[] = {0x06, 25};

	CHECK(!g6_auth_handle(&s, "8SIM00", short_req, sizeof short_req, rnd, out, &n));
	CHECK(!g6_auth_handle(&s, "8SIM00", unknown, sizeof unknown, rnd, out, &n));
	CHECK(!g6_auth_handle(&s, "8SIM00", short_req, 0, rnd, out, &n));
	CHECK(g6_auth_handle(&s, "8SIM00", keep_alive, sizeof keep_alive, rnd, out, &n) && n == 0);
}

static const char *result_name(enum g6_result r)
{
	switch (r) {
	case G6_RES_REPLY:
		return "reply";
	case G6_RES_NOT_AUTH:
		return "not authenticated";
	case G6_RES_BAD_CRC:
		return "bad crc";
	case G6_RES_UNKNOWN:
		return "unknown";
	case G6_RES_DISCONNECT:
		return "disconnect";
	case G6_RES_ACK:
		return "ack";
	}
	return "?";
}

static void test_control(void)
{
	for (size_t i = 0; i < sizeof G6V_CONTROL / sizeof G6V_CONTROL[0]; i++) {
		const struct g6v_control *c = &G6V_CONTROL[i];
		struct g6_session s = {.authenticated = c->authed != 0};
		struct g6_reading r = {.seq = c->seq,
				       .ts_s = c->ts,
				       .glucose = (uint16_t)c->glucose,
				       .state = (uint8_t)c->state,
				       .trend = (int8_t)c->trend};
		uint8_t in[32], out[G6_MAX_REPLY];
		size_t n = from_hex(c->request, in, sizeof in), out_len = 0;
		enum g6_result res =
			g6_control_handle(&s, c->has_reading ? &r : NULL, c->now_s, in, n, out, &out_len);

		total++;
		if (strcmp(result_name(res), c->result) != 0) {
			failed++;
			printf("  FAIL  control \"%s\": result %s, want %s\n", c->name,
			       result_name(res), c->result);
		}
		CHECK_BYTES(blob_of(out, out_len), c->reply, c->name);
	}
}

static void test_grid(void)
{
	struct g6_grid g;

	g6_grid_init(&g, G6V_PERIOD_S);
	for (size_t i = 0; i < sizeof G6V_TICKS / sizeof G6V_TICKS[0]; i++) {
		const struct g6v_tick *t = &G6V_TICKS[i];
		struct g6_reading r = {0};
		bool due = g6_grid_feed(&g, t->sim_s, t->glucose, t->has_trend != 0, t->trend,
					G6_STATE_OK, &r);

		CHECK(due == (t->expect != 0));
		if (due && t->expect) {
			CHECK(r.seq == t->seq);
			CHECK(r.ts_s == t->ts);
			CHECK(r.glucose == t->out_glucose);
			CHECK(r.trend == t->out_trend);
		}
	}
}

static void test_grid_restart_and_jump(void)
{
	struct g6_grid g;
	struct g6_reading r;

	g6_grid_init(&g, 300);
	CHECK(g6_grid_feed(&g, 0, 100, true, 0, G6_STATE_OK, &r) && r.seq == 0);
	CHECK(g6_grid_feed(&g, 1000, 150, true, 0, G6_STATE_OK, &r));
	CHECK(r.ts_s == 900 && r.seq == 1); /* one reading, at the latest boundary */
	CHECK(g6_grid_feed(&g, 5, 90, true, 0, G6_STATE_OK, &r)); /* the clock went back */
	CHECK(r.seq == 0 && r.ts_s == 0);
	CHECK(g6_round_half_away(-12.5) == -13 && g6_round_half_away(12.5) == 13);
	CHECK(g6_round_half_away(0.4) == 0 && g6_round_half_away(-0.4) == 0);
}

int main(void)
{
	test_crc();
	test_aes();
	test_hash();
	test_ids_and_names();
	test_auth_flow();
	test_auth_malformed();
	test_control();
	test_grid();
	test_grid_restart_and_jump();

	printf("%d checks, %d failed\n", total, failed);
	return failed ? 1 : 0;
}
