## CMakeLists.txt
```
#
# Copyright (c) 2022 Nordic Semiconductor
#
# SPDX-License-Identifier: LicenseRef-Nordic-5-Clause
#
cmake_minimum_required(VERSION 3.20.0)

find_package(Zephyr REQUIRED HINTS $ENV{ZEPHYR_BASE})
project(peripheral_cgms)

target_sources(app PRIVATE
  src/main.c
  src/sim_config.c
  src/csv_store.c
  src/config_service.c
  src/dexcom_service.c
  src/dexcom_g6.c
  src/aes128.c
  src/model_thread.c
  src/comm_thread.c
  src/models/cgmsim_cambridge.c
  src/models/cgmsim_uva_padova.c
  src/models/cgmsim_royparker.c
  src/models/cgmsim_deichmann.c
  src/models/cgmsim_sensors.c
)

target_include_directories(app PRIVATE src src/models)
```

## Kconfig
```
#
# Copyright (c) 2024 Nordic Semiconductor
#
# SPDX-License-Identifier: LicenseRef-Nordic-5-Clause
#

menu "Simulator options"

config APP_SENSOR_COUNT
	int "Simulated CGM sensors / BLE identities"
	range 1 3
	default 3
	help
	  One physical board simulates this many independent CGM sensors, each
	  with its own BLE identity / advertising set / CGMS instance and its own
	  fully independent config slot. 1 == the original single-sensor build.
	  Keep CONFIG_BT_ID_MAX / BT_MAX_CONN / BT_EXT_ADV_MAX_ADV_SET /
	  BT_CGMS_INSTANCE_COUNT in prj.conf equal to this.

config APP_CGMS_NO_AUTH
	bool "Drop the authenticated-link requirement on CGMS characteristics"
	default y if APP_SENSOR_COUNT > 1
	default n
	help
	  Fallback for the Windows LE Secure Connections pairing failure against
	  the board's non-default BLE identities. When set, the standard CGM
	  Service characteristics use BT_GATT_PERM_READ / WRITE instead of
	  *_AUTHEN, so a client streams glucose with no pairing at all
	  (acceptable for a simulator).

	  Defaults on for multi-sensor builds (APP_SENSOR_COUNT > 1): "Option B"
	  (privacy off + static addresses + peripheral-initiated security) was
	  tested on hardware and still fails on identities 1..N-1 — the board
	  logs "Security failed ... err 2" (AUTH_REQUIREMENT) and Windows drops
	  the link. Single-sensor builds default off and keep the real security
	  model (identity 0 pairs fine).

config APP_CGMS_STAGGER_NOTIFY
	bool "Round-robin the CGMS instances' periodic notifications"
	default y if APP_SENSOR_COUNT > 1
	default n
	help
	  Normally every instance's report_meas work item fires at
	  the same instant each comm_interval (they are all initialised back to
	  back at boot), so the N measurement notifications hit the controller
	  as one burst. When set, instance k is delayed by k/N of a comm_interval
	  (N = BT_CGMS_INSTANCE_COUNT), spreading them across the interval.

	  Defaults on for multi-sensor builds. Measured on hardware 2026-10-03
	  (scripts/ble_ab_batch.py, two-minute runs, 4 sensors connected at once):
	  with this on, no sensor went silent in 12 of 12 runs; with it off,
	  Sensor 4 accepted start_notify and then never notified in 12 of 12
	  runs. Only connecting Sensor 4 first on its own avoided it.

config APP_G6_WINDOW_S
	int "Dexcom board mode: seconds the G6 identity stays connectable around each reading"
	range 0 600
	default 30
	help
	  A real G6 transmitter accepts a connection only around each reading, and xDrip schedules
	  its next connection from the last one. In the Dexcom board mode the identity the phone
	  connects to therefore advertises only for this many seconds after every new reading (and
	  after a mode switch or boot), and is never cut while a client is connected.

	  0 keeps it connectable all the time. It is also effectively always open whenever the
	  speed multiplier makes the 5-minute reading grid shorter than this window.

endmenu

source "Kconfig.zephyr"

config SETTINGS
	default y

config ZMS
	default y if (SOC_FLASH_NRF_RRAM || SOC_FLASH_NRF_MRAM)

config NVS
	default y if !(SOC_FLASH_NRF_RRAM || SOC_FLASH_NRF_MRAM)
```

## prj.conf
```kconfig
#
# Copyright (c) 2022 Nordic Semiconductor
#
# SPDX-License-Identifier: LicenseRef-Nordic-5-Clause
#

# LED status indication
CONFIG_DK_LIBRARY=y

# Simulator: 3 independent CGM sensors on one board (see CONFIG_APP_SENSOR_COUNT
# in Kconfig — set it to 1 for the old single-sensor build and drop the BT
# counts below back to 1).
CONFIG_APP_SENSOR_COUNT=3

# Basic BT options
CONFIG_BT=y
CONFIG_BT_SMP=y
CONFIG_BT_APP_PASSKEY=y
# Pairing on the multi-identity build — history:
#  * "Option B" (attempted 2026-09): CONFIG_BT_PRIVACY=n (stable static
#    addresses, no RPAs) + a bond slot per identity + peripheral-initiated
#    security (bt_conn_set_security in main.c's connected()). Tested on
#    hardware against Windows: identity 0 pairs and does encrypted GATT fine,
#    but identities 1-3 fail every time — serial shows
#    "Security failed ... level 1 err 2" (BT_SECURITY_ERR_AUTH_REQUIREMENT)
#    and Windows drops the link (reason 0x13). Same unresolved Windows +
#    Zephyr multi-identity LE-SC bug as before; forced legacy pairing (the
#    old workaround) is NOT re-introduced — it broke encrypted CGMS reads.
#  * "Option A" (ACTIVE): CONFIG_APP_CGMS_NO_AUTH drops the authenticated-
#    link requirement on the CGMS characteristics, so all N identities stream
#    with no pairing at all (acceptable for a simulator). It defaults ON for
#    APP_SENSOR_COUNT > 1 (see Kconfig) — no explicit line needed here.
#    BT_PRIVACY=n is kept regardless so the secondary identities have stable,
#    scannable addresses; a single-sensor build keeps real security.
CONFIG_BT_PRIVACY=n
CONFIG_BT_MAX_PAIRED=8
CONFIG_BT_PERIPHERAL=y
CONFIG_BT_DIS=y
CONFIG_BT_DIS_PNP=n
CONFIG_BT_DEVICE_NAME="Nordic Glucose Sensor"
CONFIG_FLASH=y
CONFIG_FLASH_PAGE_LAYOUT=y
CONFIG_FLASH_MAP=y
CONFIG_BT_SETTINGS=y

# External SPI-NOR (mx25r64) driver, for the sim_config storage_partition and
# the sim_csv_partition defined in boards/nrf54l15dk_nrf54l15_cpuapp.overlay —
# the board's default devicetree enables the node itself, but not these driver
# Kconfigs.
CONFIG_SPI=y
CONFIG_SPI_NOR=y

# CRC32 (crc32_ieee_update) — used by src/csv_store.c to verify an uploaded
# CSV track against the CRC the app sends in the control BEGIN header.
CONFIG_CRC=y

# N BLE identities / advertising sets / CGMS instances — one per simulated
# sensor. Must equal CONFIG_APP_SENSOR_COUNT above.
CONFIG_BT_EXT_ADV=y
CONFIG_BT_EXT_ADV_MAX_ADV_SET=3
CONFIG_BT_ID_MAX=3
CONFIG_BT_MAX_CONN=3
# Buffer counts are left at their Zephyr defaults, which already scale with
# CONFIG_BT_MAX_CONN. Raising BT_BUF_ACL_TX_COUNT past the default trips a
# build-time assert unless BT_BUF_EVT_RX_COUNT is raised in lockstep; the CGMS
# push path already tolerates a transient -ENOMEM (it retries), so the defaults
# are fine here.
# With 4 links open, the SoftDevice Controller must fit 4 connection events
# into each interval. Its default max event length (7500 us) means 4 links at
# a ~15 ms discovery interval overrun the interval and the newest link is
# starved off mid-subscribe. Cap it so 4 events always fit; main.c also asks
# each central for a relaxed 30-50 ms interval on connect.
CONFIG_BT_CTLR_SDC_MAX_CONN_EVENT_LEN_DEFAULT=2500
# Peripheral's preferred connection parameters (sent to the central so even
# the pre-update negotiation lands near here): 30-50 ms interval, 4 s timeout.
CONFIG_BT_PERIPHERAL_PREF_MIN_INT=24
CONFIG_BT_PERIPHERAL_PREF_MAX_INT=40
CONFIG_BT_PERIPHERAL_PREF_LATENCY=0
CONFIG_BT_PERIPHERAL_PREF_TIMEOUT=400
# Needed for bt_gatt_service_register(), used internally by bt_cgms_init()
# and by our own custom config_service.c registration.
CONFIG_BT_GATT_DYNAMIC_DB=y
# dexcom_service.c refuses a G6 client's subscription outside the Dexcom board mode (the CCC write
# reaches no callback that knows the connection, so it is checked in the authorization hook).
CONFIG_BT_GATT_AUTHORIZATION_CUSTOM=y
# A full Person Config write is 137 bytes; default ATT MTU is too small.
CONFIG_BT_L2CAP_TX_MTU=247
CONFIG_BT_BUF_ACL_TX_SIZE=251
# Zephyr's ATT server rejects Prepare Write Request (needed for any write
# longer than ATT_MTU-3) with "Request Not Supported" unless this is nonzero
# — hit in practice: MTU exchange timing meant Person/Sensor Config's ~57-137
# byte writes arrived before a larger MTU was negotiated, falling back to a
# queued/long write. A too-small count then fails with "Prepare Queue Full"
# once a 137-byte write is chunked at a small (e.g. default 23-byte) MTU —
# worst case ~8 chunks, so 12 gives headroom regardless of MTU timing.
CONFIG_BT_ATT_PREPARE_COUNT=12

# CGMS Specific options
CONFIG_BT_CGMS=y
CONFIG_BT_CGMS_INSTANCE_COUNT=3
CONFIG_BT_CGMS_MAX_MEASUREMENT_RECORD=10
CONFIG_LOG=y
CONFIG_BT_CGMS_LOG_LEVEL_INF=y
CONFIG_SFLOAT=y
CONFIG_SYSTEM_WORKQUEUE_STACK_SIZE=1280

# Needed for printk's %f/%.2f etc — used by model_thread.c's per-tick debug log.
CONFIG_CBPRINTF_FP_SUPPORT=y
```

## boards/nrf54l15dk_nrf54l15_cpuapp.overlay
```dts
/*
 * Partitions the board's external SPI-NOR flash (mx25r64, on spi00 — already
 * enabled by the board's default devicetree but with no partitions defined)
 * so the simulator config (struct sim_config, see src/sim_config.h) can be
 * persisted there across reboots, per the assignment's requirement to store
 * it in external flash rather than the internal MRAM used for BT bonding.
 *
 * sim_csv_partition holds an uploaded CGM trace + Food Log (see src/csv_store.h
 * and PROTOCOL_SPEC.md's "CSV playback data source" section) — the board can
 * stream a recorded 24 h window row-per-tick instead of running a physiological
 * model. Sized generously (252 KB) so a long window and its food log fit with
 * room to spare; erased one 4 KB sector at a time on each upload.
 */

&mx25r64 {
	partitions {
		compatible = "fixed-partitions";
		#address-cells = <1>;
		#size-cells = <1>;

		sim_storage_partition: partition@0 {
			label = "sim_config_storage";
			reg = <0x00000000 0x00001000>; /* 4 KB, one erase sector */
		};

		sim_csv_partition: partition@1000 {
			label = "sim_csv_storage";
			reg = <0x00001000 0x0003F000>; /* 252 KB */
		};
	};
};
```

## src/aes128.c
```c
#include <string.h>

#include "aes128.h"

static const uint8_t sbox[256] = {
	0x63, 0x7c, 0x77, 0x7b, 0xf2, 0x6b, 0x6f, 0xc5, 0x30, 0x01, 0x67, 0x2b, 0xfe, 0xd7, 0xab, 0x76,
	0xca, 0x82, 0xc9, 0x7d, 0xfa, 0x59, 0x47, 0xf0, 0xad, 0xd4, 0xa2, 0xaf, 0x9c, 0xa4, 0x72, 0xc0,
	0xb7, 0xfd, 0x93, 0x26, 0x36, 0x3f, 0xf7, 0xcc, 0x34, 0xa5, 0xe5, 0xf1, 0x71, 0xd8, 0x31, 0x15,
	0x04, 0xc7, 0x23, 0xc3, 0x18, 0x96, 0x05, 0x9a, 0x07, 0x12, 0x80, 0xe2, 0xeb, 0x27, 0xb2, 0x75,
	0x09, 0x83, 0x2c, 0x1a, 0x1b, 0x6e, 0x5a, 0xa0, 0x52, 0x3b, 0xd6, 0xb3, 0x29, 0xe3, 0x2f, 0x84,
	0x53, 0xd1, 0x00, 0xed, 0x20, 0xfc, 0xb1, 0x5b, 0x6a, 0xcb, 0xbe, 0x39, 0x4a, 0x4c, 0x58, 0xcf,
	0xd0, 0xef, 0xaa, 0xfb, 0x43, 0x4d, 0x33, 0x85, 0x45, 0xf9, 0x02, 0x7f, 0x50, 0x3c, 0x9f, 0xa8,
	0x51, 0xa3, 0x40, 0x8f, 0x92, 0x9d, 0x38, 0xf5, 0xbc, 0xb6, 0xda, 0x21, 0x10, 0xff, 0xf3, 0xd2,
	0xcd, 0x0c, 0x13, 0xec, 0x5f, 0x97, 0x44, 0x17, 0xc4, 0xa7, 0x7e, 0x3d, 0x64, 0x5d, 0x19, 0x73,
	0x60, 0x81, 0x4f, 0xdc, 0x22, 0x2a, 0x90, 0x88, 0x46, 0xee, 0xb8, 0x14, 0xde, 0x5e, 0x0b, 0xdb,
	0xe0, 0x32, 0x3a, 0x0a, 0x49, 0x06, 0x24, 0x5c, 0xc2, 0xd3, 0xac, 0x62, 0x91, 0x95, 0xe4, 0x79,
	0xe7, 0xc8, 0x37, 0x6d, 0x8d, 0xd5, 0x4e, 0xa9, 0x6c, 0x56, 0xf4, 0xea, 0x65, 0x7a, 0xae, 0x08,
	0xba, 0x78, 0x25, 0x2e, 0x1c, 0xa6, 0xb4, 0xc6, 0xe8, 0xdd, 0x74, 0x1f, 0x4b, 0xbd, 0x8b, 0x8a,
	0x70, 0x3e, 0xb5, 0x66, 0x48, 0x03, 0xf6, 0x0e, 0x61, 0x35, 0x57, 0xb9, 0x86, 0xc1, 0x1d, 0x9e,
	0xe1, 0xf8, 0x98, 0x11, 0x69, 0xd9, 0x8e, 0x94, 0x9b, 0x1e, 0x87, 0xe9, 0xce, 0x55, 0x28, 0xdf,
	0x8c, 0xa1, 0x89, 0x0d, 0xbf, 0xe6, 0x42, 0x68, 0x41, 0x99, 0x2d, 0x0f, 0xb0, 0x54, 0xbb, 0x16,
};

static uint8_t xtime(uint8_t a)
{
	return (uint8_t)((a << 1) ^ ((a & 0x80) ? 0x1B : 0x00));
}

/* Expands the key into 11 round keys, 16 bytes each. */
static void expand_key(const uint8_t key[16], uint8_t rk[11][16])
{
	uint8_t rcon = 1;

	memcpy(rk[0], key, 16);
	for (int r = 1; r <= 10; r++) {
		const uint8_t *prev = rk[r - 1];
		uint8_t *cur = rk[r];

		cur[0] = prev[0] ^ sbox[prev[13]] ^ rcon;
		cur[1] = prev[1] ^ sbox[prev[14]];
		cur[2] = prev[2] ^ sbox[prev[15]];
		cur[3] = prev[3] ^ sbox[prev[12]];
		for (int i = 4; i < 16; i++) {
			cur[i] = prev[i] ^ cur[i - 4];
		}
		rcon = xtime(rcon);
	}
}

static void add_round_key(uint8_t s[16], const uint8_t k[16])
{
	for (int i = 0; i < 16; i++) {
		s[i] ^= k[i];
	}
}

/* SubBytes + ShiftRows (state is column-major: index = 4 * column + row). */
static void sub_shift(uint8_t s[16])
{
	uint8_t t[16];

	for (int c = 0; c < 4; c++) {
		for (int r = 0; r < 4; r++) {
			t[4 * c + r] = sbox[s[4 * ((c + r) % 4) + r]];
		}
	}
	memcpy(s, t, 16);
}

static void mix_columns(uint8_t s[16])
{
	for (int c = 0; c < 4; c++) {
		uint8_t *a = &s[4 * c];
		uint8_t t[4];

		for (int r = 0; r < 4; r++) {
			t[r] = (uint8_t)(xtime(a[r]) ^ xtime(a[(r + 1) % 4]) ^ a[(r + 1) % 4] ^
					 a[(r + 2) % 4] ^ a[(r + 3) % 4]);
		}
		memcpy(a, t, 4);
	}
}

void aes128_encrypt_block(const uint8_t key[16], const uint8_t in[16], uint8_t out[16])
{
	uint8_t rk[11][16];
	uint8_t s[16];

	expand_key(key, rk);
	memcpy(s, in, 16);
	add_round_key(s, rk[0]);
	for (int round = 1; round <= 10; round++) {
		sub_shift(s);
		if (round != 10) {
			mix_columns(s);
		}
		add_round_key(s, rk[round]);
	}
	memcpy(out, s, 16);
}
```

## src/aes128.h
```c
#ifndef AES128_H
#define AES128_H

/*
 * Minimal AES-128, encrypt direction only (FIPS-197) - all the Dexcom G6 challenge hash needs.
 * Plain C, no Zephyr, no heap, so it is built unchanged on the PC for the host tests
 * (firmware/peripheral_cgms/tests/host). Not constant-time: it protects a simulator's challenge,
 * not a secret worth attacking.
 */

#include <stdint.h>

void aes128_encrypt_block(const uint8_t key[16], const uint8_t in[16], uint8_t out[16]);

#endif /* AES128_H */
```

## src/comm_thread.c
```c
#include <string.h>
#include <errno.h>
#include <zephyr/kernel.h>
#include <zephyr/sys/printk.h>
#include <bluetooth/services/cgms.h>
#include <sfloat.h>

#include "comm_thread.h"
#include "model_thread.h"
#include "config_service.h"
#include "sim_config.h"
#include "csv_store.h"
#include "dexcom_g6.h"
#include "dexcom_service.h"

/* Defined in main.c — switch the board mode (SIM_COMM_*): identities, advertising, LEDs. */
void main_apply_comm_profile(uint8_t profile);
/* Defined in main.c — the Dexcom transmitter ID changed: re-advertise under the new name. */
void main_apply_dexcom_id(void);
/* Defined in main.c — a new G6 reading was published: open the connect window. */
void main_g6_reading_published(void);

#define COMM_THREAD_STACK_SIZE 4096
#define COMM_THREAD_PRIORITY   5
/* Deep enough for a CSV upload burst AND a full multi-slot Board Layout push
 * (send_board_layout writes sensor_select + person/sensor/data_source/food/
 * exercise per slot, ~24 messages back to back). */
#define CFG_MSGQ_DEPTH         32
#define MEASUREMENT_RETRY_COUNT 3

/* Big enough for a CSV_DATA chunk (u32 offset + bytes) at ATT MTU 247, and
 * still covers every config payload (person config, 137 B, is next largest). */
#define CFG_MSG_MAX_DATA 244

struct cfg_msg {
	enum cfg_msg_type type;
	uint16_t len;
	uint8_t data[CFG_MSG_MAX_DATA];
};

/* CSV control opcodes — first byte of a CFG_MSG_CSV_CONTROL payload. Must match
 * api/protocol.py's encode_csv_* helpers. */
#define CSV_OP_BEGIN  0x01
#define CSV_OP_COMMIT 0x02
#define CSV_OP_ABORT  0x03
#define CSV_OP_CLEAR  0x04
#define CSV_OP_STATUS 0x05
#define CSV_OP_READ   0x06

struct csv_begin_wire {
	uint8_t op;
	uint8_t track;
	uint16_t row_count;
	uint32_t base_epoch_s;
	uint16_t interval_s;
	uint32_t total_bytes;
	uint32_t crc32;
} __packed;

struct csv_track_op_wire {
	uint8_t op;
	uint8_t track;
} __packed;

struct csv_read_op_wire {
	uint8_t op;
	uint8_t track;
	uint32_t offset;
	uint16_t len;
} __packed;

struct csv_data_wire {
	uint32_t offset;
	uint8_t data[]; /* remaining bytes of the message */
} __packed;

K_MSGQ_DEFINE(cfg_msgq, sizeof(struct cfg_msg), CFG_MSGQ_DEPTH, 4);

static K_THREAD_STACK_DEFINE(comm_thread_stack, COMM_THREAD_STACK_SIZE);
static struct k_thread comm_thread_data;

static struct bt_cgms *g_cgms[MAX_SIM_SENSORS];
static K_MUTEX_DEFINE(working_cfg_lock);
static struct sim_config working_cfg;
static uint8_t working_sel; /* sensor-select cursor for per-slot config writes/reads */

uint8_t comm_thread_selected_slot(void)
{
	return working_sel;
}

/* The slot subsequent per-sensor writes target. Held under working_cfg_lock by
 * callers below. */
static struct sensor_slot *sel_slot(void)
{
	return &working_cfg.slots[working_sel];
}

int comm_thread_enqueue_config(enum cfg_msg_type type, const void *data, uint16_t len)
{
	struct cfg_msg msg = {0};

	if (len > sizeof(msg.data)) {
		return -EINVAL;
	}
	msg.type = type;
	msg.len = len;
	memcpy(msg.data, data, len);

	return (k_msgq_put(&cfg_msgq, &msg, K_NO_WAIT) == 0) ? 0 : -ENOMSG;
}

void comm_thread_copy_config(struct sim_config *out)
{
	k_mutex_lock(&working_cfg_lock, K_FOREVER);
	*out = working_cfg;
	k_mutex_unlock(&working_cfg_lock);
}

/* Read-path helpers for config_service.c: copy just the slice a GATT read
 * needs, so the ~2.85 KB struct sim_config never lands on the BT RX stack. */
void comm_thread_copy_selected_slot(struct sensor_slot *out)
{
	k_mutex_lock(&working_cfg_lock, K_FOREVER);
	*out = working_cfg.slots[working_sel];
	k_mutex_unlock(&working_cfg_lock);
}

void comm_thread_copy_selected_user_name(char out[SIM_USER_NAME_MAX])
{
	k_mutex_lock(&working_cfg_lock, K_FOREVER);
	memcpy(out, working_cfg.user_name[working_sel], SIM_USER_NAME_MAX);
	k_mutex_unlock(&working_cfg_lock);
}

/* The chunk the last CSV_OP_READ staged, served to the csv_read characteristic from RAM (the
 * flash read happens in process_csv_control, on this thread — never in a GATT callback). */
static K_MUTEX_DEFINE(csv_readback_lock);
static struct csv_readback_wire csv_readback;

uint16_t comm_thread_copy_csv_readback(struct csv_readback_wire *out)
{
	k_mutex_lock(&csv_readback_lock, K_FOREVER);
	*out = csv_readback;
	k_mutex_unlock(&csv_readback_lock);
	return CSV_READBACK_HDR + out->len;
}

void comm_thread_copy_dexcom_tx_id(char out[SIM_DEXCOM_ID_BUF])
{
	k_mutex_lock(&working_cfg_lock, K_FOREVER);
	memcpy(out, working_cfg.dexcom_tx_id, SIM_DEXCOM_ID_BUF);
	k_mutex_unlock(&working_cfg_lock);
	out[SIM_DEXCOM_ID_LEN] = '\0';
}

uint8_t comm_thread_comm_profile(void)
{
	k_mutex_lock(&working_cfg_lock, K_FOREVER);
	uint8_t p = working_cfg.comm_profile;
	k_mutex_unlock(&working_cfg_lock);

	return p;
}

float comm_thread_speed_mult(void)
{
	k_mutex_lock(&working_cfg_lock, K_FOREVER);
	float m = working_cfg.speed_mult;
	k_mutex_unlock(&working_cfg_lock);

	return m;
}

static void apply_person_msg(const uint8_t *data, uint16_t len)
{
	struct person_config_wire wire;

	if (len < sizeof(wire)) {
		return;
	}
	memcpy(&wire, data, sizeof(wire));

	k_mutex_lock(&working_cfg_lock, K_FOREVER);
	sel_slot()->model_id = wire.model_id;
	memcpy(sel_slot()->model_params, wire.params, sizeof(wire.params));
	k_mutex_unlock(&working_cfg_lock);
}

static void apply_sensor_msg(const uint8_t *data, uint16_t len)
{
	struct sensor_config_wire wire;

	if (len < sizeof(wire)) {
		return;
	}
	memcpy(&wire, data, sizeof(wire));

	k_mutex_lock(&working_cfg_lock, K_FOREVER);
	sel_slot()->sensor_id = wire.sensor_id;
	memcpy(sel_slot()->sensor_params, wire.params, sizeof(wire.params));
	k_mutex_unlock(&working_cfg_lock);
}

static void apply_sensor_select_msg(const uint8_t *data, uint16_t len)
{
	if (len < 1) {
		return;
	}
	k_mutex_lock(&working_cfg_lock, K_FOREVER);
	uint8_t n = working_cfg.sensor_count ? working_cfg.sensor_count : 1;

	working_sel = (data[0] < n) ? data[0] : 0;
	k_mutex_unlock(&working_cfg_lock);
	printk("comm_thread: sensor_select -> %u\n", working_sel);
}

/* The payload is the bare name (0..SIM_USER_NAME_MAX-2 bytes); anything longer is
 * refused by the GATT write, so this only ever sees a name that fits. */
static void apply_user_name_msg(const uint8_t *data, uint16_t len)
{
	if (len > SIM_USER_NAME_MAX - 1) {
		return;
	}
	k_mutex_lock(&working_cfg_lock, K_FOREVER);
	char *dst = working_cfg.user_name[working_sel];

	memset(dst, 0, SIM_USER_NAME_MAX);
	memcpy(dst, data, len);
	k_mutex_unlock(&working_cfg_lock);
}

static void apply_data_source_msg(const uint8_t *data, uint16_t len)
{
	if (len < 1) {
		return;
	}
	k_mutex_lock(&working_cfg_lock, K_FOREVER);
	sel_slot()->data_source = (data[0] == SIM_DATA_CSV) ? SIM_DATA_CSV : SIM_DATA_MODEL;
	k_mutex_unlock(&working_cfg_lock);
}

static void apply_speed_msg(const uint8_t *data, uint16_t len)
{
	struct speed_wire w;

	if (len < sizeof(w)) {
		return;
	}
	memcpy(&w, data, sizeof(w));
	if (!(w.mult >= SIM_SPEED_MIN && w.mult <= SIM_SPEED_MAX)) {
		w.mult = (w.mult < SIM_SPEED_MIN) ? SIM_SPEED_MIN : SIM_SPEED_MAX;
	}
	k_mutex_lock(&working_cfg_lock, K_FOREVER);
	working_cfg.speed_mult = w.mult;
	k_mutex_unlock(&working_cfg_lock);
}

/* The 5-minute grid and the trend's previous point (Dexcom board mode). */
static struct g6_grid g6_grid;
static bool g6_prev_valid;
static double g6_prev_glucose;
static double g6_prev_sim_s;
/* After a mode switch the model thread applies the new config (clock back to 0) on its next tick,
 * up to a second later; the sample still waiting from before that is stale and must not become a
 * reading. */
static int g6_skip_samples;

static void g6_restart(void)
{
	g6_grid_init(&g6_grid, G6_PERIOD_S);
	g6_prev_valid = false;
	g6_skip_samples = 0;
	dexcom_service_reset();
}

/* A board-mode write (from BLE, or the button via the same queue). Returns true if the mode
 * actually changed — a write of the current mode is not worth a restart. Entering Dexcom mode
 * forces speed x1: xDrip polls in wall-clock 5 minutes. The slot cursor goes back to slot 0, the
 * only sensor that runs in Dexcom mode. */
static bool apply_comm_profile_msg(const uint8_t *data, uint16_t len)
{
	if (len < 1) {
		return false;
	}
	uint8_t p = (data[0] == SIM_COMM_DEXCOM) ? SIM_COMM_DEXCOM : SIM_COMM_SIG_CGMS;

	k_mutex_lock(&working_cfg_lock, K_FOREVER);
	bool changed = working_cfg.comm_profile != p;

	if (changed) {
		working_cfg.comm_profile = p;
		working_cfg.sensor_count = sim_config_sensor_count_for(p);
		working_sel = 0;
		if (p == SIM_COMM_DEXCOM) {
			working_cfg.speed_mult = 1.0f;
		}
	}
	k_mutex_unlock(&working_cfg_lock);
	if (!changed) {
		return false;
	}
	g6_restart();
	g6_skip_samples = 1; /* the sample in flight predates the simulation reset */
	main_apply_comm_profile(p);
	return true;
}

/* CFG_MSG_DEXCOM_ID: the GATT write already refused anything that is not six digits/capitals. */
static void apply_dexcom_id_msg(const uint8_t *data, uint16_t len)
{
	if (!g6_valid_id((const char *)data, len)) {
		return;
	}
	k_mutex_lock(&working_cfg_lock, K_FOREVER);
	memcpy(working_cfg.dexcom_tx_id, data, SIM_DEXCOM_ID_LEN);
	working_cfg.dexcom_tx_id[SIM_DEXCOM_ID_LEN] = '\0';
	k_mutex_unlock(&working_cfg_lock);
	main_apply_dexcom_id();
}

/* CFG_MSG_CSV_CONTROL — opcode-tagged, handled straight through csv_store_*
 * (erase/commit run here, off the BT host context, like sim_config_save_to_flash).
 * BEGIN/COMMIT/STATUS reply on the CSV control notify. */
static void process_csv_control(const uint8_t *data, uint16_t len)
{
	if (len < 1) {
		return;
	}

	switch (data[0]) {
	case CSV_OP_BEGIN: {
		struct csv_begin_wire w;

		if (len < sizeof(w)) {
			config_service_notify_csv_control(CSV_CTRL_STATUS_ERR, 0);
			return;
		}
		memcpy(&w, data, sizeof(w));
		struct csv_upload_header hdr = {
			.track = w.track,
			.row_count = w.row_count,
			.base_epoch_s = w.base_epoch_s,
			.interval_s = w.interval_s,
			.total_bytes = w.total_bytes,
			.crc32 = w.crc32,
		};
		int err = csv_store_begin(comm_thread_selected_slot(), &hdr);

		config_service_notify_csv_control(
			err ? CSV_CTRL_STATUS_ERR : CSV_CTRL_STATUS_OK, csv_store_received());
		break;
	}
	case CSV_OP_COMMIT: {
		struct csv_track_op_wire w;

		if (len < sizeof(w)) {
			config_service_notify_csv_control(CSV_CTRL_STATUS_ERR, 0);
			return;
		}
		memcpy(&w, data, sizeof(w));
		int err = csv_store_commit(comm_thread_selected_slot(), w.track, NULL);

		config_service_notify_csv_control(
			err ? CSV_CTRL_STATUS_ERR : CSV_CTRL_STATUS_OK, csv_store_received());
		break;
	}
	case CSV_OP_ABORT:
		csv_store_abort();
		config_service_notify_csv_control(CSV_CTRL_STATUS_OK, 0);
		break;
	case CSV_OP_CLEAR: {
		struct csv_track_op_wire w;

		if (len < sizeof(w)) {
			config_service_notify_csv_control(CSV_CTRL_STATUS_ERR, 0);
			return;
		}
		memcpy(&w, data, sizeof(w));
		int err = csv_store_clear(comm_thread_selected_slot(), w.track);

		config_service_notify_csv_control(
			err ? CSV_CTRL_STATUS_ERR : CSV_CTRL_STATUS_OK, 0);
		break;
	}
	case CSV_OP_STATUS:
		config_service_notify_csv_control(CSV_CTRL_STATUS_OK, csv_store_received());
		break;
	case CSV_OP_READ: {
		struct csv_read_op_wire w;
		struct csv_readback_wire chunk;

		if (len < sizeof(w)) {
			config_service_notify_csv_control(CSV_CTRL_STATUS_ERR, 0);
			return;
		}
		memcpy(&w, data, sizeof(w));
		int err = csv_store_readback(comm_thread_selected_slot(), w.track, w.offset, w.len,
					     &chunk);

		if (err) {
			config_service_notify_csv_control(CSV_CTRL_STATUS_ERR, 0);
			break;
		}
		k_mutex_lock(&csv_readback_lock, K_FOREVER);
		csv_readback = chunk;
		k_mutex_unlock(&csv_readback_lock);
		/* The app reads the csv_read characteristic only after this arrives. */
		config_service_notify_csv_control(CSV_CTRL_STATUS_OK, chunk.len);
		break;
	}
	default:
		config_service_notify_csv_control(CSV_CTRL_STATUS_ERR, 0);
		break;
	}
}

static void process_csv_data(const uint8_t *data, uint16_t len)
{
	struct csv_data_wire hdr;

	if (len <= sizeof(hdr)) {
		return;
	}
	memcpy(&hdr, data, sizeof(hdr));
	csv_store_write(hdr.offset, data + sizeof(hdr), len - sizeof(hdr));
}

static void apply_food_event_msg(const uint8_t *data, uint16_t len)
{
	struct food_event ev;

	if (len < sizeof(ev)) {
		return;
	}
	memcpy(&ev, data, sizeof(ev));

	k_mutex_lock(&working_cfg_lock, K_FOREVER);
	if (ev.time_min == 0xFFFF) {
		sel_slot()->food_count = 0;
	} else if (sel_slot()->food_count < MAX_EVENTS) {
		sel_slot()->food[sel_slot()->food_count++] = ev;
	}
	k_mutex_unlock(&working_cfg_lock);
}

static void apply_exercise_event_msg(const uint8_t *data, uint16_t len)
{
	struct exercise_event ev;

	if (len < sizeof(ev)) {
		return;
	}
	memcpy(&ev, data, sizeof(ev));

	k_mutex_lock(&working_cfg_lock, K_FOREVER);
	if (ev.time_min == 0xFFFF) {
		sel_slot()->exercise_count = 0;
	} else if (sel_slot()->exercise_count < MAX_EVENTS) {
		sel_slot()->exercise[sel_slot()->exercise_count++] = ev;
	}
	k_mutex_unlock(&working_cfg_lock);
}

/* ~3 KB, too big for the comm_thread stack. process_cfg_msg() only ever runs on the
 * comm_thread, one message at a time. */
static struct sim_config snapshot;

static void process_cfg_msg(const struct cfg_msg *msg)
{
	printk("comm_thread: cfg write received, type=%d len=%u\n", msg->type, msg->len);

	if (msg->type == CFG_MSG_RUN_STATE) {
		/* Live session control, not part of sim_config — apply directly,
		 * skip the flash-save path below entirely. */
		if (msg->len >= 1) {
			model_thread_set_run_state(msg->data[0]);
		}
		return;
	}

	if (msg->type == CFG_MSG_FOOD_INSTANT) {
		/* Not part of sim_config, and deliberately NOT routed through
		 * model_thread_apply_config() below — that would reset
		 * sim_clock_min/model state, defeating the point of an instant,
		 * non-disruptive mid-run injection. */
		struct food_instant_wire wire;

		if (msg->len >= sizeof(wire)) {
			memcpy(&wire, msg->data, sizeof(wire));
			model_thread_add_instant_food(comm_thread_selected_slot(),
						      wire.duration_min, wire.carbs_g);
		}
		return;
	}

	if (msg->type == CFG_MSG_EXERCISE_INSTANT) {
		struct exercise_instant_wire wire;

		if (msg->len >= sizeof(wire)) {
			memcpy(&wire, msg->data, sizeof(wire));
			model_thread_add_instant_exercise(comm_thread_selected_slot(),
							  wire.duration_min, wire.intensity_pct);
		}
		return;
	}

	if (msg->type == CFG_MSG_FOOD_INSTANT_ALL) {
		struct food_instant_wire wire;

		if (msg->len >= sizeof(wire)) {
			memcpy(&wire, msg->data, sizeof(wire));
			for (int s = 0; s < SIM_SENSOR_COUNT; s++) {
				model_thread_add_instant_food(s, wire.duration_min, wire.carbs_g);
			}
		}
		return;
	}

	if (msg->type == CFG_MSG_EXERCISE_INSTANT_ALL) {
		struct exercise_instant_wire wire;

		if (msg->len >= sizeof(wire)) {
			memcpy(&wire, msg->data, sizeof(wire));
			for (int s = 0; s < SIM_SENSOR_COUNT; s++) {
				model_thread_add_instant_exercise(s, wire.duration_min,
								  wire.intensity_pct);
			}
		}
		return;
	}

	if (msg->type == CFG_MSG_PISA_INSTANT_ALL) {
		struct pisa_instant_wire wire;

		if (msg->len >= sizeof(wire)) {
			memcpy(&wire, msg->data, sizeof(wire));
			for (int s = 0; s < SIM_SENSOR_COUNT; s++) {
				model_thread_add_instant_pisa(s, wire.duration_min, wire.depth_frac);
			}
		}
		return;
	}

	if (msg->type == CFG_MSG_PISA_INSTANT) {
		struct pisa_instant_wire wire;

		if (msg->len >= sizeof(wire)) {
			memcpy(&wire, msg->data, sizeof(wire));
			model_thread_add_instant_pisa(comm_thread_selected_slot(),
						      wire.duration_min, wire.depth_frac);
		}
		return;
	}

	if (msg->type == CFG_MSG_SENSOR_SELECT) {
		apply_sensor_select_msg(msg->data, msg->len);
		return; /* cursor only — nothing to persist or re-apply */
	}

	if (msg->type == CFG_MSG_USER_NAME) {
		/* Persisted, but deliberately NOT routed through
		 * model_thread_apply_config(): a name is metadata, and applying would
		 * reset sim_clock_min and the instant events like a model write does. */
		apply_user_name_msg(msg->data, msg->len);
		comm_thread_copy_config(&snapshot);
		sim_config_save_to_flash(&snapshot);
		return;
	}

	if (msg->type == CFG_MSG_DEXCOM_ID) {
		/* Persisted metadata, like the user name: no sim reset. */
		apply_dexcom_id_msg(msg->data, msg->len);
		comm_thread_copy_config(&snapshot);
		sim_config_save_to_flash(&snapshot);
		return;
	}

	if (msg->type == CFG_MSG_CGMS_ONLY) {
		if (msg->len >= 1) {
			model_thread_set_cgms_only(msg->data[0] != 0);
		}
		return;
	}

	if (msg->type == CFG_MSG_CSV_CONTROL) {
		process_csv_control(msg->data, msg->len);
		return;
	}

	if (msg->type == CFG_MSG_CSV_DATA) {
		process_csv_data(msg->data, msg->len);
		return;
	}

	switch (msg->type) {
	case CFG_MSG_PERSON:
		apply_person_msg(msg->data, msg->len);
		break;
	case CFG_MSG_SENSOR:
		apply_sensor_msg(msg->data, msg->len);
		break;
	case CFG_MSG_MODE:
		break; /* legacy on/off mode byte — removed from struct, ignored */
	case CFG_MSG_DATA_SOURCE:
		apply_data_source_msg(msg->data, msg->len);
		break;
	case CFG_MSG_SPEED:
		apply_speed_msg(msg->data, msg->len);
		break;
	case CFG_MSG_COMM_PROFILE:
		if (!apply_comm_profile_msg(msg->data, msg->len)) {
			return; /* already in that mode: nothing to restart, nothing to save */
		}
		break;
	case CFG_MSG_FOOD_EVENT:
		apply_food_event_msg(msg->data, msg->len);
		break;
	case CFG_MSG_EXERCISE_EVENT:
		apply_exercise_event_msg(msg->data, msg->len);
		break;
	}

	comm_thread_copy_config(&snapshot);
	sim_config_save_to_flash(&snapshot);
	model_thread_apply_config(&snapshot);
}

/* Adds one glucose value to slot s's CGMS instance (retrying briefly, see below). */
static void cgms_push(int s, float glucose_mg_dl)
{
	struct bt_cgms_measurement result;

	if (!g_cgms[s]) {
		return;
	}
	result.glucose = sfloat_from_float(glucose_mg_dl);
	for (int i = 0; i < MEASUREMENT_RETRY_COUNT; i++) {
		int err = bt_cgms_measurement_add(g_cgms[s], result);

		if (err == 0) {
			printk("comm_thread: pushed slot %d glucose=%.2f\n", s, glucose_mg_dl);
			return;
		}
		/* Short retry: a dropped measurement is re-sent on the next push anyway, and
		 * with N connections this loop must not starve the config message queue
		 * (Board Layout push). */
		k_sleep(K_MSEC(40));
	}
}

/* Dexcom board mode, slot 0: one reading per 5 simulated minutes, held until the next. The same
 * reading goes to the G6 characteristics (xDrip pulls it) and, once, to the CGMS instance the
 * app reads — so both readers see exactly the same points. */
static void dexcom_tick(const struct model_measurement *meas)
{
	struct g6_reading r;

	if (g6_skip_samples > 0) {
		g6_skip_samples--;
		return;
	}
	if (meas->sim_s < g6_prev_sim_s) {
		g6_prev_valid = false; /* the simulated clock restarted */
	}
	double dt_min = (meas->sim_s - g6_prev_sim_s) / 60.0;
	bool has_trend = g6_prev_valid && dt_min > 0.5;
	double trend = has_trend ? ((double)meas->glucose_mg_dl - g6_prev_glucose) / dt_min : 0.0;

	dexcom_service_set_clock((uint32_t)meas->sim_s);
	if (!g6_grid_feed(&g6_grid, meas->sim_s, meas->glucose_mg_dl, has_trend, trend,
			  G6_STATE_OK, &r)) {
		return;
	}
	g6_prev_valid = true;
	g6_prev_glucose = meas->glucose_mg_dl;
	g6_prev_sim_s = meas->sim_s;
	dexcom_service_publish(&r);
	printk("comm_thread: dexcom reading seq=%u ts=%us glucose=%u trend=%d\n", r.seq, r.ts_s,
	       r.glucose, r.trend);
	cgms_push(0, (float)r.glucose);
	main_g6_reading_published();
}

static void push_measurement_and_status(void)
{
	k_mutex_lock(&working_cfg_lock, K_FOREVER);
	uint8_t comm_profile = working_cfg.comm_profile;
	uint8_t count = working_cfg.sensor_count ? working_cfg.sensor_count : 1;
	k_mutex_unlock(&working_cfg_lock);

	if (count > MAX_SIM_SENSORS) {
		count = MAX_SIM_SENSORS;
	}
	bool dexcom = (comm_profile == SIM_COMM_DEXCOM);
	bool cgms_only = model_thread_get_cgms_only();

	for (int s = 0; s < count; s++) {
		struct model_measurement meas;

		model_thread_take_measurement(s, &meas);

		/* meas.valid gates only the glucose push; carbs/exercise in meas
		 * are always current, so the per-slot status notify below fires
		 * every tick regardless. */
		if (meas.valid && dexcom) {
			dexcom_tick(&meas);
		} else if (meas.valid) {
			cgms_push(s, meas.glucose_mg_dl);
		}

		if (cgms_only) {
			continue;
		}
		/* Food/Exercise Status, per slot: {u8 slot; u8 _pad; f32 carbs; f32 ex} */
		uint8_t payload[10];

		payload[0] = (uint8_t)s;
		payload[1] = 0;
		memcpy(payload + 2, &meas.carbs_g_per_min, sizeof(float));
		memcpy(payload + 6, &meas.exercise_pct, sizeof(float));
		config_service_notify_food_exercise_status(payload, sizeof(payload));
	}
}

static void comm_thread_entry(void *p1, void *p2, void *p3)
{
	ARG_UNUSED(p1);
	ARG_UNUSED(p2);
	ARG_UNUSED(p3);

	while (1) {
		struct cfg_msg msg;
		int err = k_msgq_get(&cfg_msgq, &msg, K_MSEC(500));

		if (err == 0) {
			process_cfg_msg(&msg);
		}

		push_measurement_and_status();
	}
}

void comm_thread_start(struct bt_cgms **cgms, const struct sim_config *initial_cfg)
{
	g6_restart();
	for (int i = 0; i < MAX_SIM_SENSORS; i++) {
		g_cgms[i] = cgms[i];
	}

	k_mutex_lock(&working_cfg_lock, K_FOREVER);
	working_cfg = *initial_cfg;
	k_mutex_unlock(&working_cfg_lock);

	k_thread_create(&comm_thread_data, comm_thread_stack, COMM_THREAD_STACK_SIZE,
			 comm_thread_entry, NULL, NULL, NULL, COMM_THREAD_PRIORITY, 0,
			 K_NO_WAIT);
	k_thread_name_set(&comm_thread_data, "comm_thread");
}
```

## src/comm_thread.h
```c
#ifndef COMM_THREAD_H
#define COMM_THREAD_H

/*
 * Owns BLE communication: pushes CGMS measurements + Food/Exercise Status
 * notifications from the model thread's latest output, and applies config
 * writes (queued here by config_service.c's GATT write callbacks, which run
 * in BT host context and must stay short) — persisting each to flash and
 * handing it to model_thread. Runs on its own k_thread, separate from
 * model_thread, per the assignment's two-thread requirement.
 */

#include <stdint.h>
#include <bluetooth/services/cgms.h>

#include "csv_store.h"
#include "sim_config.h"

enum cfg_msg_type {
	CFG_MSG_PERSON,
	CFG_MSG_SENSOR,
	CFG_MSG_MODE,
	CFG_MSG_FOOD_EVENT,
	CFG_MSG_EXERCISE_EVENT,
	CFG_MSG_RUN_STATE, /* not part of sim_config — never persisted to flash */
	/* Instant (one-shot) events — not part of sim_config, never persisted,
	 * and deliberately NOT routed through model_thread_apply_config(): see
	 * model_thread.h's struct food_instant_wire comment. Applied directly
	 * to model_thread's live instant-event slots. */
	CFG_MSG_FOOD_INSTANT,
	CFG_MSG_EXERCISE_INSTANT,
	/* Instant PISA attenuation — not part of sim_config, never persisted,
	 * applied directly to model_thread's live PISA slots (like the food/
	 * exercise instant events). */
	CFG_MSG_PISA_INSTANT,
	/* CGMS-only mode toggle — not part of sim_config, never persisted. See
	 * model_thread.h's model_thread_set_cgms_only() comment. */
	CFG_MSG_CGMS_ONLY,
	/* Data source (SIM_DATA_MODEL / SIM_DATA_CSV) — part of sim_config,
	 * persisted like person/sensor/mode. */
	CFG_MSG_DATA_SOURCE,
	/* Speed multiplier (float32, SIM_SPEED_MIN..SIM_SPEED_MAX) — part of
	 * sim_config, persisted. Replaces the legacy on/off CFG_MSG_MODE. */
	CFG_MSG_SPEED,
	/* BLE comm profile (SIM_COMM_SIG_CGMS / SIM_COMM_DEXCOM) — part of
	 * sim_config, persisted. Triggers a re-advertise (main_apply_comm_profile). */
	CFG_MSG_COMM_PROFILE,
	/* Uploaded-CSV transport (see csv_store.h / PROTOCOL_SPEC.md). CONTROL
	 * carries an opcode-tagged BEGIN/COMMIT/ABORT/CLEAR/STATUS payload; DATA
	 * carries u32 offset + track bytes. Handled straight through csv_store_*,
	 * not routed through model_thread_apply_config(). */
	CFG_MSG_CSV_CONTROL,
	CFG_MSG_CSV_DATA,
	/* Sensor-select cursor — NOT persisted. Sets which of the sensor_count
	 * slots subsequent person/sensor/food/exercise/data-source/CSV writes and
	 * reads target. See PROTOCOL_SPEC.md's "Sensor select" section. */
	CFG_MSG_SENSOR_SELECT,
	/* Name of the user on the selected slot — part of sim_config (persisted) but
	 * metadata only: saved to flash WITHOUT model_thread_apply_config(), so it
	 * never resets the simulation. See PROTOCOL_SPEC.md's "User name" section. */
	CFG_MSG_USER_NAME,
	/* Dexcom G6 transmitter ID (6 chars, digits/capitals) — part of sim_config (persisted),
	 * metadata only like the user name (no sim reset). Re-advertises in Dexcom board mode: the
	 * advertised name derives from it. See PROTOCOL_SPEC.md's "Dexcom transmitter ID" section. */
	CFG_MSG_DEXCOM_ID,
	/* The board buttons' meal / exercise: the same payloads as CFG_MSG_FOOD_INSTANT /
	 * CFG_MSG_EXERCISE_INSTANT, but injected into EVERY sensor slot — a button has no way to
	 * say which sensor it means, and the sensor-select cursor is whatever the app addressed last. */
	CFG_MSG_FOOD_INSTANT_ALL,
	CFG_MSG_EXERCISE_INSTANT_ALL,
	CFG_MSG_PISA_INSTANT_ALL,
};

/* Enqueue a config write for comm_thread to apply. Thread-safe, non-blocking
 * — safe to call from a GATT write callback. Returns 0 on success, a
 * negative errno if the queue is full or *data is too large. */
int comm_thread_enqueue_config(enum cfg_msg_type type, const void *data, uint16_t len);

/* Starts comm_thread. *cgms is an array of the CGMS service instances (one per
 * sensor slot) to push measurements to; *initial_cfg seeds the in-RAM working
 * copy comm_thread serves GATT reads from. Call once at boot. */
void comm_thread_start(struct bt_cgms **cgms, const struct sim_config *initial_cfg);

/* Thread-safe snapshot of the config comm_thread currently has applied —
 * used by config_service.c's read callbacks to serve GATT reads directly
 * from RAM (no flash access on the read path). */
void comm_thread_copy_config(struct sim_config *out);

/* Narrow read-path accessors for config_service.c — avoid copying the whole
 * ~2.85 KB struct sim_config onto the BT RX stack just to serve one field.
 * comm_thread_copy_selected_slot() returns the slot the sensor-select cursor
 * currently points at (what every per-sensor GATT read serves). */
void comm_thread_copy_selected_slot(struct sensor_slot *out);
/* Copies the selected slot's user name (always NUL-terminated) into out. */
void comm_thread_copy_selected_user_name(char out[SIM_USER_NAME_MAX]);
/* Copies the staged CSV readback chunk (the last CSV_OP_READ's answer) into *out and returns how
 * many bytes of it are meaningful: CSV_READBACK_HDR plus its `len`. */
uint16_t comm_thread_copy_csv_readback(struct csv_readback_wire *out);
uint8_t comm_thread_comm_profile(void);
/* Copies the Dexcom transmitter ID (always NUL-terminated) into out. Thread-safe. */
void comm_thread_copy_dexcom_tx_id(char out[SIM_DEXCOM_ID_BUF]);
float comm_thread_speed_mult(void);

/* The slot index (0..sensor_count-1) that per-sensor config reads/writes
 * currently target — set by the sensor-select characteristic. */
uint8_t comm_thread_selected_slot(void);

#endif /* COMM_THREAD_H */
```

## src/config_service.h
```c
#ifndef CONFIG_SERVICE_H
#define CONFIG_SERVICE_H

/*
 * Custom "simulator config" GATT service — see SensorSimulator/PROTOCOL_SPEC.md
 * §2 for the authoritative UUID/byte-layout contract. Registered automatically
 * at boot via BT_GATT_SERVICE_DEFINE; config_service_init() just logs.
 */

#include <stdint.h>

/* CSV control notify status byte (see config_service_notify_csv_control). */
#define CSV_CTRL_STATUS_OK  0
#define CSV_CTRL_STATUS_ERR 1

void config_service_init(void);

/* Notifies the Food/Exercise Status characteristic if anyone has subscribed.
 * *data must be the 10-byte per-slot wire payload
 * {uint8_t slot; uint8_t _pad; float carbs_g_per_min; float exercise_pct;} —
 * one notification per active sensor slot per tick. Returns 0 on success; a
 * negative errno (commonly meaning "nobody is subscribed yet") is expected
 * and safe to ignore. */
int config_service_notify_food_exercise_status(const void *data, uint16_t len);

/* Notifies the Reset Sync characteristic the instant a config/state reset
 * actually takes effect (called from model_thread.c's apply_config_locked()).
 * True clock synchronization: the app anchors its own t=0 to the arrival of
 * this notification instead of to whenever it sent the write that caused the
 * reset, eliminating the BLE round-trip + processing latency (up to a
 * couple seconds, worse in fast mode) that otherwise shows up as a visible
 * phase shift between the app's local model and the board's. Payload is a
 * single incrementing byte (generation counter) — its arrival time is the
 * signal, the value itself is only for diagnostics. Return value: see
 * config_service_notify_food_exercise_status(). */
int config_service_notify_reset_sync(void);

/* Notifies the CSV Control characteristic with the outcome of a CSV control
 * opcode (BEGIN/COMMIT/ABORT/CLEAR/STATUS): 2-byte {u8 status, ...} followed by
 * u32 received_bytes, little-endian — 6 bytes total. *status is
 * CSV_CTRL_STATUS_OK / CSV_CTRL_STATUS_ERR. The app waits on this between the
 * BEGIN and the first data chunk, and again after COMMIT. Return value: see
 * config_service_notify_food_exercise_status(). */
int config_service_notify_csv_control(uint8_t status, uint32_t received_bytes);

#endif /* CONFIG_SERVICE_H */
```

## src/csv_store.h
```c
#ifndef CSV_STORE_H
#define CSV_STORE_H

/*
 * Uploaded-CSV storage + playback lookup, backed by the external SPI-NOR
 * sim_csv_partition (see boards/nrf54l15dk_nrf54l15_cpuapp.overlay). The app
 * uploads two "tracks" over BLE (see PROTOCOL_SPEC.md's "CSV playback data
 * source" section):
 *
 *   - CSV_TRACK_GLUCOSE : int16 mg/dL samples, evenly spaced interval_s apart,
 *                         starting at base_epoch_s. When sim_config.data_source
 *                         is SIM_DATA_CSV, model_thread emits one of these per
 *                         tick as the CGM Measurement (verbatim, no sensor
 *                         noise), looping when the window ends.
 *   - CSV_TRACK_FOODLOG : {u32 offset_s; float carbs_g} meal entries (seconds
 *                         from base_epoch_s). Report-only — surfaced in the
 *                         Food/Exercise Status notification, never fed to a
 *                         model.
 *
 * Upload is chunked: csv_store_begin() (erase + header), repeated
 * csv_store_write() (offset + bytes), csv_store_commit() (CRC check + manifest
 * write). The manifest lives in the last used sector of the partition so
 * playback is autonomous across reboots (csv_store_load_manifest() at boot).
 */

#include <stdbool.h>
#include <stddef.h>
#include <stdint.h>
#include <zephyr/toolchain.h>

#include "sim_config.h" /* MAX_SIM_SENSORS */

#define CSV_TRACK_GLUCOSE 0
#define CSV_TRACK_FOODLOG 1
#define CSV_TRACK_COUNT   2

/* Each of the MAX_SIM_SENSORS slots has its own independent glucose + foodlog
 * track in sim_csv_partition — so a mixed board (e.g. 3 CSV + 1 model) works. */

/* Parsed CSV control BEGIN payload (see PROTOCOL_SPEC.md). */
struct csv_upload_header {
	uint8_t track;
	uint32_t row_count;
	uint32_t base_epoch_s;
	uint16_t interval_s; /* glucose sample spacing; unused for foodlog */
	uint32_t total_bytes;
	uint32_t crc32;
};

/* One report-only meal, returned by csv_foodlog_window(). */
struct csv_food_hit {
	float carbs_g;
};

/* CSV readback (CSV_OP_READ + the csv_read characteristic, PROTOCOL_SPEC.md): one chunk of a
 * committed track plus the track's header, so the app can rebuild what a slot is replaying.
 * Wire layout, little-endian; 22 bytes of header then `len` bytes of the track. */
#define CSV_READBACK_MAX 200
#define CSV_READBACK_HDR 22

struct csv_readback_wire {
	uint8_t track;
	uint8_t present;       /* 0: nothing committed for this slot/track (len is then 0) */
	uint16_t interval_s;
	uint32_t row_count;
	uint32_t base_epoch_s;
	uint32_t byte_len;     /* the whole track, so the app knows when it has all of it */
	uint32_t offset;       /* where in the track `data` starts */
	uint16_t len;          /* bytes of `data` that follow */
	uint8_t data[CSV_READBACK_MAX];
} __packed;

BUILD_ASSERT(offsetof(struct csv_readback_wire, data) == CSV_READBACK_HDR,
	     "csv_readback_wire header must stay 22 bytes (the app parses it)");

/* Fill *out with slot/track's header and up to *max_len* bytes (<= CSV_READBACK_MAX) of it from
 * *offset*. A slot/track with nothing committed gives present = 0 and len = 0 (not an error);
 * an offset past the end gives len = 0. Reads flash: call from comm_thread, not the BT host
 * context. Returns 0, or a negative errno on a bad argument or a flash error. */
int csv_store_readback(uint8_t slot, uint8_t track, uint32_t offset, uint16_t max_len,
		       struct csv_readback_wire *out);

/* Begin an upload into *slot*'s track: validates the header, erases just enough
 * sectors for total_bytes, arms the write cursor. Returns 0 on success. */
int csv_store_begin(uint8_t slot, const struct csv_upload_header *hdr);

/* Program len bytes at *offset* within the in-progress track (offset relative
 * to the track, not the partition). Returns 0 on success. */
int csv_store_write(uint32_t offset, const uint8_t *data, uint16_t len);

/* Finish the in-progress upload for slot/*track*: checks received bytes + CRC32,
 * on success writes the manifest and refreshes the in-RAM playback state.
 * *crc_ok (may be NULL) reports the CRC result. */
int csv_store_commit(uint8_t slot, uint8_t track, bool *crc_ok);

/* Discard the in-progress upload without touching the committed manifest. */
void csv_store_abort(void);

/* Wipe slot/*track*'s manifest entry. Returns 0 on success. */
int csv_store_clear(uint8_t slot, uint8_t track);

/* Bytes received so far for the in-progress upload (for the STATUS opcode). */
uint32_t csv_store_received(void);

/* Load the manifest from flash and populate the in-RAM playback state for all
 * slots. Call once at boot, after sim_config_load_from_flash(). */
void csv_store_load_manifest(void);

/* True if *slot* has a committed glucose track available for playback. */
bool csv_glucose_available(uint8_t slot);

/* Look up *slot*'s glucose sample for sim_clock_min, looping at the window end.
 * Returns false (and leaves *out_mg_dl untouched) if no glucose track. */
bool csv_glucose_lookup(uint8_t slot, double sim_clock_min, float *out_mg_dl);

/* Fill up to max entries for *slot*'s meals in the half-open simulated-seconds
 * window [t0_s, t1_s) (mod the playback span). Returns the number written. */
int csv_foodlog_window(uint8_t slot, double t0_s, double t1_s,
		       struct csv_food_hit *out, int max);

#endif /* CSV_STORE_H */
```

## src/dexcom_service.h
```c
#ifndef DEXCOM_SERVICE_H
#define DEXCOM_SERVICE_H

/*
 * The GATT face of the Dexcom G6 board mode: a transmitter xDrip can authenticate against and read.
 * The protocol itself (CRC, the AES challenge, request -> reply, the 5-minute grid) lives in
 * dexcom_g6.c and is tested on the PC; this file only moves bytes between GATT and that module and
 * keeps the per-connection authentication state.
 *
 * Characteristics (base F8083532-849E-531C-C594-30F1F86A4EA5, as xDrip's BluetoothServices):
 *   ...3533 Communication  read + notify
 *   ...3534 Control        write + indicate   commands in, replies out
 *   ...3535 Authentication write + read + indicate
 *   ...3536 Backfill       notify
 *   ...3538 ExtraData      notify
 * No characteristic requires encryption: the board reports itself "already bonded" and the G6
 * challenge (keyed by the transmitter ID, sim_config.dexcom_tx_id) is the only gate. The service is
 * registered unconditionally but answers only in the Dexcom board mode.
 *
 * A G6 never streams: the client connects, authenticates, asks for the reading, and leaves. The
 * board keeps the latest reading and answers requests from it.
 */

#include <stdint.h>

#include "dexcom_g6.h"

/* Forget the held reading and the transmitter clock (mode switch, boot). */
void dexcom_service_reset(void);

/* Make *r the reading clients are served until the next one. */
void dexcom_service_publish(const struct g6_reading *r);

/* The transmitter clock in seconds (simulated time); answered to a time request. */
void dexcom_service_set_clock(uint32_t now_s);

#endif /* DEXCOM_SERVICE_H */
```
